## realgui/3rd/sim_experimental/Kconfig
```kconfig
# 3rd Party Libraries Configuration

menu "Framework Configuration"

choice
    prompt "Select Demo Module"
    default REALTEK_BUILD_LITE3D

config REALTEK_BUILD_NONE
    bool "None"
    help
      No demo module enabled

config REALTEK_BUILD_TVG
    bool "ThorVG"
    help
      Enable ThorVG vector graphics library

config REALTEK_BUILD_GIFDEC
    bool "GIFDEC"
    help
      Enable GIF decoder library

config REALTEK_BUILD_LITE3D
    bool "RTK Lite3D"
    help
      Enable RTK Lite3D library

config REALTEK_BUILD_GUI_USE_ARM2D
    bool "ARM2D"
    help
      Enable ARM2D acceleration library

config REALTEK_BUILD_H264
    bool "H264"
    help
      Enable H264 video codec

config REALTEK_BUILD_OPENGL
    bool "OpenGL"
    help
      Enable OpenGL test module

endchoice

choice
    prompt "Lite3D Source Configuration"
    depends on REALTEK_BUILD_LITE3D
    default REALTEK_BUILD_REAL_BUTTERFLY_3D

config REALTEK_BUILD_REAL_BUTTERFLY_3D
    bool "Butterfly 3D Demo"

config REALTEK_BUILD_REAL_PRISM_MIRROR_3D
    bool "Prism Mirror 3D Demo"

config REALTEK_BUILD_REAL_FACE_3D
    bool "Face 3D Demo"

config REALTEK_BUILD_REAL_DOG_3D
    bool "Dog 3D Demo"

config REALTEK_BUILD_REAL_DISC_3D
    bool "Disc 3D Demo"

config REALTEK_BUILD_REAL_PRISM_THICK_3D
    bool "Prism Thick 3D Demo"

config REALTEK_BUILD_REAL_APPLIST_3D
    bool "AppList 3D Demo"

endchoice

endmenu
```

## realgui/3rd/win32_sim/Kconfig
```kconfig
# 3rd Party Libraries Configuration

menu "Framework Configuration"

config REALTEK_BUILD_TVG
    bool "Enable ThorVG"
    default n
    help
      Enable ThorVG vector graphics library

config REALTEK_BUILD_GIFDEC
    bool "Enable GIFDEC"
    default n
    help
      Enable GIF decoder library

config REALTEK_BUILD_LITE3D
    bool "Enable RTK Lite3D"
    default y
    help
      Enable RTK Lite3D library

config REALTEK_BUILD_GUI_USE_ARM2D
    bool "Enable ARM2D"
    default y
    help
      Enable ARM2D acceleration library

endmenu

menu "Lite3D Source Configuration"
    depends on REALTEK_BUILD_LITE3D

config REALTEK_BUILD_LITE3D_SOURCE
    bool "Enable Lite3D Source"
    default y
    help
      Enable Lite3D source code

config REALTEK_BUILD_REAL_BUTTERFLY_3D
    bool "Butterfly 3D Demo"
    default y
    depends on REALTEK_BUILD_LITE3D_SOURCE
    help
      Enable Butterfly 3D demo

config REALTEK_BUILD_REAL_PRISM_MIRROR_3D
    bool "Prism Mirror 3D Demo"
    default n
    depends on REALTEK_BUILD_LITE3D_SOURCE
    help
      Enable Prism Mirror 3D demo

config REALTEK_BUILD_REAL_FACE_3D
    bool "Face 3D Demo"
    default n
    depends on REALTEK_BUILD_LITE3D_SOURCE
    help
      Enable Face 3D demo

config REALTEK_BUILD_REAL_DOG_3D
    bool "Dog 3D Demo"
    default n
    depends on REALTEK_BUILD_LITE3D_SOURCE
    help
      Enable Dog 3D demo

config REALTEK_BUILD_REAL_DISC_3D
    bool "Disc 3D Demo"
    default n
    depends on REALTEK_BUILD_LITE3D_SOURCE
    help
      Enable Disc 3D demo

config REALTEK_BUILD_REAL_PRISM_THICK_3D
    bool "Prism Thick 3D Demo"
    default n
    depends on REALTEK_BUILD_LITE3D_SOURCE
    help
      Enable Prism Thick 3D demo

config REALTEK_BUILD_REAL_APPLIST_3D
    bool "AppList 3D Demo"
    default n
    depends on REALTEK_BUILD_LITE3D_SOURCE
    help
      Enable AppList 3D demo

endmenu
```

## tool/kconfig.py
```kconfig
#
# Copyright (c) 2026, Realtek Semiconductor Corporation
#
# SPDX-License-Identifier: MIT
#
#!/usr/bin/env python3

import argparse
import os
import sys
import textwrap

from kconfiglib import Kconfig, split_expr, expr_value, expr_str, BOOL, \
                       TRISTATE, TRI_TO_STR, AND, OR

def _cmake_contents(kconfig, header):
    chunks = [header]
    add = chunks.append
    config_vars = []
    for sym in kconfig.unique_defined_syms:
        # _write_to_conf is determined when the value is calculated. This
        # is a hidden function call due to property magic.
        val = sym.str_value
        if not sym._write_to_conf:
            continue
        if sym.orig_type in (BOOL, TRISTATE) and val == "n":
            val = ""
        add("set({}{} \"{}\")\n".format(
            kconfig.config_prefix, sym.name, val))
        config_vars.append(str(kconfig.config_prefix+sym.name))

    add("set(CONFIGS_LIST {})\n".format(";".join(config_vars)))
    
    return "".join(chunks)

def write_cmake(kconfig, filename):
    print("cmake  config  saved to: " + filename)
    
    cmake_conf_header = "# Generated for source code\n"
    cmake_conf_header += "### DO NOT edit this file!! ###\n\n"
    cmake_conf_content = _cmake_contents(kconfig, cmake_conf_header)
    # don't change file info if config no change
    if os.path.exists(filename):
        with open(filename) as f:
            if f.read() == cmake_conf_content:
                return
    f = open(filename, "w")
    f.write(cmake_conf_content)
    f.close()
    print("generated cmake config {}".format(filename))

def main():
    args = parse_args()

    if args.board:
        os.environ["BOARD_DIR"] = args.board

    print("Parsing " + args.kconfig_file)
    kconf = Kconfig(args.kconfig_file, warn_to_stderr=False,
                    suppress_traceback=True)

    # Load configuration files
    print(kconf.load_config(args.configs_in[0],False))
    for config in args.configs_in[1:]:
        # replace=False creates a merged configuration
        print(kconf.load_config(config, replace=False))

    # if kconf.syms['WARN_DEPRECATED'].tri_value == 2:
    #     check_deprecated(kconf)

    # if kconf.syms['WARN_EXPERIMENTAL'].tri_value == 2:
    #     check_experimental(kconf)

    # Hack: Force all symbols to be evaluated, to catch warnings generated
    # during evaluation. Wait till the end to write the actual output files, so
    # that we don't generate any output if there are warnings-turned-errors.
    #
    # Kconfiglib caches calculated symbol values internally, so this is still
    # fast.
    kconf.write_config(os.devnull)

    if kconf.warnings:
        # Put a blank line between warnings to make them easier to read
        for warning in kconf.warnings:
            print("\n" + warning, file=sys.stderr)

        # Turn all warnings into errors, so that e.g. assignments to undefined
        # Kconfig symbols become errors.
        #
        # A warning is generated by this script whenever a symbol gets a
        # different value than the one it was assigned. Keep that one as just a
        # warning for now.
        err("Aborting due to Kconfig warnings")

    # Write the merged configuration and the C header
    print(kconf.write_config(args.config_out))
    print(kconf.write_autoconf(args.header_out))
    print(write_cmake(kconf,args.cmake_out))

    # Write the list of parsed Kconfig files to a file
    write_kconfig_filenames(kconf, args.kconfig_list_out)


def check_no_promptless_assign(kconf):
    # Checks that no promptless symbols are assigned

    for sym in kconf.unique_defined_syms:
        if sym.user_value is not None and promptless(sym):
            err(f"""\
{sym.name_and_loc} is assigned in a configuration file, but is not directly
user-configurable (has no prompt). It gets its value indirectly from other
symbols. """ + SYM_INFO_HINT.format(sym))


def check_assigned_sym_values(kconf):
    # Verifies that the values assigned to symbols "took" (matches the value
    # the symbols actually got), printing warnings otherwise. Choice symbols
    # are checked separately, in check_assigned_choice_values().

    for sym in kconf.unique_defined_syms:
        if sym.choice:
            continue

        user_value = sym.user_value
        if user_value is None:
            continue

        # Tristate values are represented as 0, 1, 2. Having them as "n", "m",
        # "y" is more convenient here, so convert.
        if sym.type in (BOOL, TRISTATE):
            user_value = TRI_TO_STR[user_value]

        if user_value != sym.str_value:
            msg = f"{sym.name_and_loc} was assigned the value '{user_value}'" \
                  f" but got the value '{sym.str_value}'. "

            # List any unsatisfied 'depends on' dependencies in the warning
            mdeps = missing_deps(sym)
            if mdeps:
                expr_strs = []
                for expr in mdeps:
                    estr = expr_str(expr)
                    if isinstance(expr, tuple):
                        # Add () around dependencies that aren't plain symbols.
                        # Gives '(FOO || BAR) (=n)' instead of
                        # 'FOO || BAR (=n)', which might be clearer.
                        estr = f"({estr})"
                    expr_strs.append(f"{estr} "
                                     f"(={TRI_TO_STR[expr_value(expr)]})")

                msg += "Check these unsatisfied dependencies: " + \
                    ", ".join(expr_strs) + ". "

            warn(msg + SYM_INFO_HINT.format(sym))


def missing_deps(sym):
    # check_assigned_sym_values() helper for finding unsatisfied dependencies.
    #
    # Given direct dependencies
    #
    #     depends on <expr> && <expr> && ... && <expr>
    #
    # on 'sym' (which can also come from e.g. a surrounding 'if'), returns a
    # list of all <expr>s with a value less than the value 'sym' was assigned
    # ("less" instead of "not equal" just to be general and handle tristates,
    # even though Zephyr doesn't use them).
    #
    # For string/int/hex symbols, just looks for <expr> = n.
    #
    # Note that <expr>s can be something more complicated than just a symbol,
    # like 'FOO || BAR' or 'FOO = "string"'.

    deps = split_expr(sym.direct_dep, AND)

    if sym.type in (BOOL, TRISTATE):
        return [dep for dep in deps if expr_value(dep) < sym.user_value]
    # string/int/hex
    return [dep for dep in deps if expr_value(dep) == 0]


def check_assigned_choice_values(kconf):
    # Verifies that any choice symbols that were selected (by setting them to
    # y) ended up as the selection, printing warnings otherwise.
    #
    # We check choice symbols separately to avoid warnings when two different
    # choice symbols within the same choice are set to y. This might happen if
    # a choice selection from a board defconfig is overridden in a prj.conf,
    # for example. The last choice symbol set to y becomes the selection (and
    # all other choice symbols get the value n).
    #
    # Without special-casing choices, we'd detect that the first symbol set to
    # y ended up as n, and print a spurious warning.

    for choice in kconf.unique_choices:
        if choice.user_selection and \
           choice.user_selection is not choice.selection:

            warn(f"""\
The choice symbol {choice.user_selection.name_and_loc} was selected (set =y),
but {choice.selection.name_and_loc if choice.selection else "no symbol"} ended
up as the choice selection. """ + SYM_INFO_HINT.format(choice.user_selection))


# Hint on where to find symbol information. Used like
# SYM_INFO_HINT.format(sym).
SYM_INFO_HINT = """\
See http://docs.zephyrproject.org/latest/kconfig.html#CONFIG_{0.name} and/or
look up {0.name} in the menuconfig/guiconfig interface. The Application
Development Primer, Setting Configuration Values, and Kconfig - Tips and Best
Practices sections of the manual might be helpful too.\
"""


def check_deprecated(kconf):
    deprecated = kconf.syms['DEPRECATED']
    dep_expr = deprecated.rev_dep

    if dep_expr is not kconf.n:
        selectors = [s for s in split_expr(dep_expr, OR) if expr_value(s) == 2]
        for selector in selectors:
            selector_name = split_expr(selector, AND)[0].name
            warn(f'Deprecated symbol {selector_name} is enabled.')


def check_experimental(kconf):
    experimental = kconf.syms['EXPERIMENTAL']
    dep_expr = experimental.rev_dep

    if dep_expr is not kconf.n:
        selectors = [s for s in split_expr(dep_expr, OR) if expr_value(s) == 2]
        for selector in selectors:
            selector_name = split_expr(selector, AND)[0].name
            warn(f'Experimental symbol {selector_name} is enabled.')


def promptless(sym):
    # Returns True if 'sym' has no prompt. Since the symbol might be defined in
    # multiple locations, we need to check all locations.

    return not any(node.prompt for node in sym.nodes)


def write_kconfig_filenames(kconf, kconfig_list_path):
    # Writes a sorted list with the absolute paths of all parsed Kconfig files
    # to 'kconfig_list_path'. The paths are realpath()'d, and duplicates are
    # removed. This file is used by CMake to look for changed Kconfig files. It
    # needs to be deterministic.

    with open(kconfig_list_path, 'w') as out:
        for path in sorted({os.path.realpath(os.path.join(kconf.srctree, path))
                            for path in kconf.kconfig_filenames}):
            print(path, file=out)


def parse_args():
    parser = argparse.ArgumentParser(allow_abbrev=False)

    parser.add_argument("kconfig_file",
                        help="Top-level Kconfig file")
    parser.add_argument("--board",choices=['RTL8773D', "RTL8773E","RTL8763E","RTL8773U"],default = "RTL8773D",
                        help="Top-level Kconfig file")
    parser.add_argument("config_out",
                        help="Output configuration file")
    parser.add_argument("header_out",
                        help="Output header file")
    parser.add_argument("cmake_out",
                        help="Output cmake config file")
    parser.add_argument("kconfig_list_out",
                        help="Output file for list of parsed Kconfig files")
    parser.add_argument("configs_in",
                        nargs="+",
                        help="Input configuration fragments. Will be merged "
                             "together.")

    return parser.parse_args()


def warn(msg):
    print("\n" + textwrap.fill("warning: " + msg, 100) + "\n", file=sys.stderr)


def err(msg):
    sys.exit("\n" + textwrap.fill("error: " + msg, 100) + "\n")


if __name__ == "__main__":
    main()
```
