## win32_sim/Kconfig
```kconfig
menu "Example Configuration"

config EXAMPLE_TYPE
    help
      Select the type of example you are configuring:
      * Watch
      * Dashboard
      * Smart Home
      * LVGL
      * RVD XML/JS

choice
    prompt "Select Example"
    default WATCH

config WATCH
    bool "Watch"
    help
      Configure settings for a Watch example.

config DASHBOARD
    bool "Dashboard"
    help
      Configure settings for a Dashboard example.

config SMART_HOME
    bool "Smart Home"
    help
      Configure settings for a Smart Home example.

config LVGL
    bool "LVGL"
    help
      Configure settings for an LVGL example.

config RVD
    bool "RVD"
    help
      Configure settings for an example using RVD tools with XML and JavaScript scripts.

endchoice

# Existing automatic set config options
config JAVASCRIPT_PARSER_SaaA
    bool
    default y if SMART_HOME

config JAVASCRIPT_PARSER_SaaA
    bool
    default y if RVD
# New configuration for RVD XML/JS
choice
    depends on RVD
    prompt "RVD"
    default RVD_TEST
    help
      Select the configuration type for the RVD example.

config RVD_TEST
    bool "TEST Configuration"
    help
      Use a basic setup for RVD development.


endchoice

# Existing watch configuration
choice
    depends on WATCH
    prompt "Watch Resolution"
    default WATCH_RESOLUTION_454x454
    help
      Choose the screen resolution for the Watch example.

config WATCH_RESOLUTION_454x454
    bool "454x454 Resolution"

config WATCH_RESOLUTION_410x502
    bool "410x502 Resolution"

endchoice

# Existing dashboard configuration
choice
    depends on DASHBOARD
    prompt "Dashboard Resolution"
    default DASHBOARD_RESOLUTION_800x480
    help
      Choose the screen resolution for the Dashboard example.

config DASHBOARD_RESOLUTION_800x480
    bool "800x480 Resolution"

endchoice

# Existing smart home configuration
choice
    depends on SMART_HOME
    prompt "Smart Home Resolution"
    default SMART_HOME_RESOLUTION_480x480
    help
      Choose the screen resolution for the Smart Home example.

config SMART_HOME_RESOLUTION_480x480
    bool "480x480 Resolution"

config SMART_HOME_RESOLUTION_480x320
    bool "480x320 Resolution"

endchoice

# Existing LVGL configuration
choice
    depends on LVGL
    prompt "LVGL Demo Selection"
    default LVGL_WIDGETS_DEMO
    help
      Select the LVGL demo you want to configure.

config LVGL_WIDGETS_DEMO
    bool "Widgets Demo"

config LVGL_BENCHMARK
    bool "Benchmark"

config LVGL_ARC_2
    bool "Arc 2"

endchoice

endmenu

config LIB_MODE
    bool "Compile as a Library"
    help
      Enable this option to compile the project as a library instead of an executable.
```
